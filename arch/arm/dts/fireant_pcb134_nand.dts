// SPDX-License-Identifier: (GPL-2.0+ OR MIT)
/*
 * Copyright (c) 2018 Microsemi Corporation
 */

/dts-v1/;
#include "mscc,fireant_pcb134.dtsi"
#include "mscc,fireant_nand.dtsi"

/ {
	model = "FireAnt PCB134/NAND Reference Board";
	compatible = "mscc,fireant-pcb134", "mscc,fireant";
};
