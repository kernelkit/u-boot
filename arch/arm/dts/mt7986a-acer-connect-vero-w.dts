// SPDX-License-Identifier: GPL-2.0

/dts-v1/;
#include "mt7986a-bpi-r3-emmc.dts"

/ {
	model = "Acer Connect Vero W";
	compatible = "acer,connect-vero-w", "mediatek,mt7986";
};

&{/memory@40000000} {
	reg = <0x40000000 0x40000000>;
};
