// SPDX-License-Identifier: (GPL-2.0+ OR MIT)
/*
 * Copyright (c) 2018 Microsemi Corporation
 */

/dts-v1/;
#include "mscc,fireant_pcb134.dtsi"

/ {
	model = "FireAnt PCB134/eMMC Reference Board";
	compatible = "mscc,fireant-pcb134", "mscc,fireant";
};

&gpio {
	emmc_pins: emmc-pins {
		// NB: No "GPIO_35", "GPIO_36", "GPIO_37"
		// (N/A: CARD_nDETECT, CARD_WP, CARD_LED)
		pins = "GPIO_34", "GPIO_38", "GPIO_39",
			"GPIO_40", "GPIO_41", "GPIO_42",
			"GPIO_43", "GPIO_44", "GPIO_45",
			"GPIO_46", "GPIO_47";
		drive-strength = <3>;
		function = "emmc";
	};
};

&sdhci0 {
	status = "okay";
	max-frequency = <52000000>;
	bus-width = <8>;
	mscc,clock-delay = <10>;
};
